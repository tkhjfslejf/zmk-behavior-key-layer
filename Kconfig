## Kconfig
```kconfig
config ZMK_BEHAVIOR_KEY_LAYER
    bool "Key plus temporary layer behavior"
    default y
```

## dts/bindings/behaviors/zmk,behavior-key-layer.yaml
```yaml
description: >
  Hold a simulated key while temporarily activating a layer.
  Release the simulated key when another physical key is pressed,
  but keep the layer active until the trigger key is released.

compatible: "zmk,behavior-key-layer"

include: two_param.yaml

properties:
  release_on_other_key:
    type: boolean
    required: false
    default: false
```
